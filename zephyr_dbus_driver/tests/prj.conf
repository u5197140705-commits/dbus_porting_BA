## CMakeLists.txt
```
cmake_minimum_required(VERSION 3.20.0)


find_package(Zephyr COMPONENTS unittest REQUIRED HINTS $ENV{ZEPHYR_BASE})
project(dbus_driver_tests)
FILE(GLOB app_sources src/*.c ../src/dbus_app_layer.c) # Include all .c files in src/
target_sources(dbus_driver_tests PRIVATE ${app_sources})
target_include_directories(dbus_driver_tests PRIVATE ${CMAKE_CURRENT_SOURCE_DIR}/inc ${CMAKE_CURRENT_SOURCE_DIR}/../inc)
target_compile_definitions(dbus_driver_tests PRIVATE CONFIG_SYS_CLOCK_TICKS_PER_SEC=1000) # Define for test build
target_compile_options(dbus_driver_tests PRIVATE -mfloat-abi=softfp -DARCH_STACK_PTR_ALIGN=8)
```

## Kconfig
```
# Kconfig for DBus driver tests

source "/home/wis3re/dbus_porting/zephyr_dbus_driver/Kconfig"
```

## prj.conf
```kconfig
# Project configuration for DBus driver tests

# Enable ZTest for unit testing
CONFIG_ZTEST=y
CONFIG_FPU_SHARING=n
CONFIG_FPU=n
CONFIG_NEWLIB_LIBC=y
CONFIG_PICOLIBC=n


# Enable console and printk for test output
CONFIG_CONSOLE=y
CONFIG_PRINTK=y

# Enable SPI driver for tests (even if mocked, Kconfig might require it)
CONFIG_SPI=y
CONFIG_GPIO=y

# Configurations from main project
CONFIG_HEAP_MEM_POOL_SIZE=256
CONFIG_MAIN_STACK_SIZE=1024
CONFIG_SYSTEM_WORKQUEUE_STACK_SIZE=1024
CONFIG_SYS_CLOCK_EXISTS=y
CONFIG_SPI_INIT_PRIORITY=50
CONFIG_DBAL_CROSS_CONNECTION=y
CONFIG_SPI_MCUX_FLEXCOMM=y
CONFIG_DBAL_TARGET_ADDRESS=0x00
```

## inc/mock_types.h
```c
#ifndef ZEPHYR_MOCK_TYPES_H__
#define ZEPHYR_MOCK_TYPES_H__

#include <stdint.h>
#include <zephyr/kernel.h> // For struct k_msgq
#include <zephyr/drivers/spi.h> // For spi_callback_t and other SPI types
#include <zephyr/devicetree.h> // For struct dt_node_label

// Define a type for the SPI RX callback function
typedef void (*spi_rx_callback_t)(const uint8_t *data, uint8_t len);

// Mock variables for spi_abstraction (declared as extern here)
extern bool mock_spi_send_called;
extern uint8_t mock_spi_send_data[128];
extern uint8_t mock_spi_send_len;
extern spi_rx_callback_t mock_rx_callback;
extern struct k_msgq *mock_spi_rx_msg_queue;
extern struct k_msgq dbal_spi_rx_msg_queue; // Declare the actual message queue as extern
extern bool mock_spi_init_return_value; // Mock return value for spi_abstraction_init

// Variables to inject specific RX data for testing
extern uint8_t mock_rx_data_to_inject[128];
extern uint8_t mock_rx_len_to_inject;
extern bool mock_rx_data_ready;

// Mock function declaration for __wrap_spi_abstraction_send
bool __wrap_spi_abstraction_send(const uint8_t *data, uint8_t len);

// Mock function declaration for __wrap_printk
int __wrap_printk(const char *fmt, ...);
extern char mock_printk_buffer[256];
extern size_t mock_printk_buffer_idx;
extern void mock_printk_reset(void);

// Mock variables for k_timer
extern bool mock_k_timer_start_called;
extern bool mock_k_timer_stop_called;
extern k_timeout_t mock_k_timer_remaining_get_return_value;

// Mock variables and functions for dbal_con_msg_timer_cb
extern bool mock_dbal_send_connection_message_called;
extern enum DBAL_ConnectionMessageType mock_dbal_send_connection_message_type;
extern bool mock_dbal_handle_con_msg_tx_fail_called;

void __wrap_dbal_send_connection_message(struct dbal_instance* inst, enum DBAL_ConnectionMessageType con_message_type);
void __wrap_dbal_handle_con_msg_tx_fail(struct dbal_instance* inst);

// Mock variables and functions for dbal_msg_timer_cb and dbal_msg_timer_action
extern bool mock_dbal_check_task_code_section_flag_return_value;
extern bool mock_dbal_set_code_section_flag_called;
extern uint8_t mock_dbal_set_code_section_flag_mask;
extern bool mock_dbal_is_msg_of_dbal_type_to_repeat_return_value;
extern bool mock_dbal_io_dbus_handler_send_called;
extern bool mock_dbal_io_dbus_handler_send_return_value;
extern bool mock_dbal_clear_msgs_to_repeat_called;
extern bool mock_dbal_clear_retry_counters_called;
extern bool mock_dbal_connection_sm_called;
extern enum DBAL_ConnectionSmEvent mock_dbal_connection_sm_event;
extern bool mock_dbal_organize_msgs_to_repeat_called;

bool __wrap_dbal_check_task_code_section_flag(const struct dbal_instance* const inst);
void __wrap_dbal_set_code_section_flag(struct dbal_instance* inst, uint8_t mask);
bool __wrap_dbal_is_msg_of_dbal_type_to_repeat(enum DBAL_MessageType dbal_type);
bool __wrap_dbal_io_dbus_handler_send(struct dbal_instance* inst, enum DBAL_MessageType dbal_type, uint16_t service_id, uint16_t command_id, const uint8_t* bytes, uint8_t data_len, uint8_t repetition);
void __wrap_dbal_clear_msgs_to_repeat(struct dbal_instance* inst);
void __wrap_dbal_clear_retry_counters(struct dbal_instance* inst);
void __wrap_dbal_connection_sm(struct dbal_instance* inst, enum DBAL_ConnectionSmEvent event);
void __wrap_dbal_organize_msgs_to_repeat(struct dbal_instance* inst);

// Mock variables and functions for spi_abstraction_init failure cases
extern const struct device *mock_device_dt_get_return_value;
extern bool mock_device_is_ready_return_value;
extern int mock_spi_transceive_cb_return_value;

const struct device *__wrap_device_dt_get(const void *label); // Changed to void* to avoid dt_node_label definition issues
bool __wrap_device_is_ready(const struct device *dev);
int __wrap_spi_transceive_cb(const struct device *dev, const struct spi_config *config,
                             const struct spi_buf_set *tx_bufs, const struct spi_buf_set *rx_bufs,
                             spi_callback_t callback, void *user_data);

// Mock variables and functions for spi_transceive_callback
extern int mock_k_msgq_put_return_value;
extern int mock_spi_transceive_cb_rearm_return_value;

int __wrap_k_msgq_put(struct k_msgq *msgq, const void *data, k_timeout_t timeout);

// Mock variables and functions for spi_abstraction_receive and spi_abstraction_transceive (blocking)
extern int mock_spi_read_return_value;
extern int mock_spi_transceive_blocking_return_value;

int __wrap_spi_read(const struct device *dev, const struct spi_config *config,
                    const struct spi_buf_set *rx_bufs);
int __wrap_spi_transceive(const struct device *dev, const struct spi_config *config,
                          const struct spi_buf_set *tx_bufs, const struct spi_buf_set *rx_bufs);

#endif // ZEPHYR_MOCK_TYPES_H__
```

## inc/spi_abstraction.h
```c
#ifndef ZEPHYR_SPI_ABSTRACTION_H__
#define ZEPHYR_SPI_ABSTRACTION_H__

#include <stdbool.h>
#include <stdint.h>
#include <zephyr/kernel.h> // For struct k_msgq
#include "mock_types.h" // Include the standalone mock types
#include <zephyr/drivers/spi.h> // For spi_callback_t and spi_transceive_cb



// Mock variables for spi_abstraction (declared as extern here)
extern bool mock_spi_send_called;
extern uint8_t mock_spi_send_data[128];
extern uint8_t mock_spi_send_len;
extern spi_rx_callback_t mock_rx_callback;
extern struct k_msgq *mock_spi_rx_msg_queue;

// Mock function declarations for spi_abstraction
int spi_abstraction_init(void);
int spi_abstraction_send(const uint8_t *tx_data, size_t tx_len, uint8_t *rx_data, size_t rx_len);
// The following functions are not part of the main spi_abstraction.h and are likely test-specific.
// They will be commented out or removed if not used in tests.
// bool spi_abstraction_receive(uint8_t *buffer, uint8_t len);
// bool spi_abstraction_transceive(const uint8_t *tx_data, uint8_t *rx_buffer, uint8_t len);
void spi_abstraction_register_rx_callback(spi_rx_callback_t callback);
void spi_abstraction_set_rx_msg_queue(struct k_msgq *msg_q);

// Functions for testing SPI RX timeout
uint32_t spi_abstraction_get_rx_timeout_count(void);
void spi_abstraction_reset_rx_timeout_count(void);

#endif // ZEPHYR_SPI_ABSTRACTION_H__
```

## inc/test_common.h
```c
#ifndef ZEPHYR_DBUS_DRIVER_TESTS_INC_TEST_COMMON_H_
#define ZEPHYR_DBUS_DRIVER_TESTS_INC_TEST_COMMON_H_

#include <zephyr/ztest.h>
#include <zephyr/kernel.h>
#include <string.h>
#include "dbus_app_layer.h"
#include "mock_types.h" // Include the standalone mock types
#include "spi_abstraction.h" // Include the mock spi_abstraction.h

// Placeholder definitions for DBAL constants used in tests
#define DBAL_OWN_NODE_ADDRESS 0x00 // Example value, adjust as per actual system config
#define SPI_SOF_BYTE          0xAA // Example value, adjust as per actual SPI protocol

// Common DBus frame constants for testing
#define DBAL_SERVICE_ID_TEST  0x1001
#define DBAL_COMMAND_ID_TEST  0x0001
#define DBAL_STATUS_OK        0x00
#define DBAL_FRAME_MIN_LEN    10 // SOF (1) + Length Field (2) + Service ID (2) + Command ID (2) + Payload (1) + CRC (2)
#define DBAL_FRAME_DATA_LEN   7  // Service ID (2) + Command ID (2) + Payload (1) + CRC (2)

// Test suite setup and teardown declarations
void dbal_setup(void *fixture);
void dbal_teardown(void *fixture);

#endif // ZEPHYR_DBUS_DRIVER_TESTS_INC_TEST_COMMON_H_
```

## src/minimal_test.c
```c
#include <zephyr/ztest.h>

ZTEST_SUITE(minimal_suite, NULL, NULL, NULL, NULL, NULL);

ZTEST(minimal_suite, test_true_assertion)
{
    zassert_true(true, "This should always be true");
}
```

## src/test_common.c
```c
#include "test_common.h"
#include <stdarg.h> // For va_list and va_start/end
#include <stdio.h>  // For vsnprintf

// Mock variables for spi_abstraction (defined here)
bool mock_spi_send_called = false;
uint8_t mock_spi_send_data[128];
uint8_t mock_spi_send_len = 0;
spi_rx_callback_t mock_rx_callback = NULL;
struct k_msgq *mock_spi_rx_msg_queue = NULL;
bool mock_spi_init_return_value = true; // Default to true for successful init

// Variables to inject specific RX data for testing
uint8_t mock_rx_data_to_inject[128];
uint8_t mock_rx_len_to_inject = 0;
bool mock_rx_data_ready = false;

// Mock variables for k_timer
bool mock_k_timer_start_called = false;
bool mock_k_timer_stop_called = false;
k_timeout_t mock_k_timer_remaining_get_return_value = K_NO_WAIT;

// Mock variables for dbal_con_msg_timer_cb
bool mock_dbal_send_connection_message_called = false;
enum DBAL_ConnectionMessageType mock_dbal_send_connection_message_type = DBAL_CON_MSG_TYPE_COUNT; // Initialize to an invalid type
bool mock_dbal_handle_con_msg_tx_fail_called = false;

// Mock variables for dbal_msg_timer_cb and dbal_msg_timer_action
bool mock_dbal_check_task_code_section_flag_return_value = false;
bool mock_dbal_set_code_section_flag_called = false;
uint8_t mock_dbal_set_code_section_flag_mask = 0;
bool mock_dbal_is_msg_of_dbal_type_to_repeat_return_value = false;
bool mock_dbal_io_dbus_handler_send_called = false;
bool mock_dbal_io_dbus_handler_send_return_value = true; // Default to success
bool mock_dbal_clear_msgs_to_repeat_called = false;
bool mock_dbal_clear_retry_counters_called = false;
bool mock_dbal_connection_sm_called = false;
enum DBAL_ConnectionSmEvent mock_dbal_connection_sm_event = DBAL_CON_SM_EVENT_ENABLE_REQUEST; // Default to a valid event
bool mock_dbal_organize_msgs_to_repeat_called = false;

// Mock variables for spi_abstraction_init failure cases
const struct device *mock_device_dt_get_return_value = (const struct device *)1; // Default to a non-NULL value
bool mock_device_is_ready_return_value = true;
int mock_spi_transceive_cb_return_value = 0;

// Mock variables for spi_transceive_callback
int mock_k_msgq_put_return_value = 0; // Default to success
int mock_spi_transceive_cb_rearm_return_value = 0; // Default to success

// Mock variables for spi_abstraction_receive and spi_abstraction_transceive (blocking)
int mock_spi_read_return_value = 0; // Default to success
int mock_spi_transceive_blocking_return_value = 0; // Default to success

// Mock variables for spi_abstraction_receive and spi_abstraction_transceive (blocking)
int mock_spi_read_return_value = 0; // Default to success
int mock_spi_transceive_blocking_return_value = 0; // Default to success

// Mock variables for printk capture
char mock_printk_buffer[256];
size_t mock_printk_buffer_idx = 0;

void mock_printk_reset(void) {
    memset(mock_printk_buffer, 0, sizeof(mock_printk_buffer));
    mock_printk_buffer_idx = 0;
}

// Mock function for printk to capture output
int __wrap_printk(const char *fmt, ...) {
    va_list args;
    int ret;

    va_start(args, fmt);
    ret = vsnprintf(mock_printk_buffer + mock_printk_buffer_idx,
                    sizeof(mock_printk_buffer) - mock_printk_buffer_idx,
                    fmt, args);
    va_end(args);

    if (ret > 0) {
        mock_printk_buffer_idx += ret;
        if (mock_printk_buffer_idx >= sizeof(mock_printk_buffer)) {
            mock_printk_buffer_idx = sizeof(mock_printk_buffer) - 1; // Prevent overflow
        }
    }
    return ret;
}

// Mock function implementations for dbal_con_msg_timer_cb
void __wrap_dbal_send_connection_message(struct dbal_instance* const inst, enum DBAL_ConnectionMessageType con_message_type) {
    ARG_UNUSED(inst);
    mock_dbal_send_connection_message_called = true;
    mock_dbal_send_connection_message_type = con_message_type;
    printk("MOCK: __wrap_dbal_send_connection_message called with type %u.\n", con_message_type);
}

void __wrap_dbal_handle_con_msg_tx_fail(struct dbal_instance* const inst) {
    ARG_UNUSED(inst);
    mock_dbal_handle_con_msg_tx_fail_called = true;
    printk("MOCK: __wrap_dbal_handle_con_msg_tx_fail called.\n");
}

// Mock function implementations for dbal_msg_timer_cb and dbal_msg_timer_action
bool __wrap_dbal_check_task_code_section_flag(const struct dbal_instance* const inst) {
    ARG_UNUSED(inst);
    printk("MOCK: __wrap_dbal_check_task_code_section_flag called. Returning %d.\n", mock_dbal_check_task_code_section_flag_return_value);
    return mock_dbal_check_task_code_section_flag_return_value;
}

void __wrap_dbal_set_code_section_flag(struct dbal_instance* const inst, uint8_t mask) {
    ARG_UNUSED(inst);
    mock_dbal_set_code_section_flag_called = true;
    mock_dbal_set_code_section_flag_mask = mask;
    printk("MOCK: __wrap_dbal_set_code_section_flag called with mask 0x%02x.\n", mask);
}

bool __wrap_dbal_is_msg_of_dbal_type_to_repeat(enum DBAL_MessageType dbal_type) {
    ARG_UNUSED(dbal_type);
    printk("MOCK: __wrap_dbal_is_msg_of_dbal_type_to_repeat called. Returning %d.\n", mock_dbal_is_msg_of_dbal_type_to_repeat_return_value);
    return mock_dbal_is_msg_of_dbal_type_to_repeat_return_value;
}

bool __wrap_dbal_io_dbus_handler_send(struct dbal_instance* const inst, enum DBAL_MessageType dbal_type, uint16_t service_id, uint16_t command_id, const uint8_t* const bytes, uint8_t data_len, uint8_t repetition) {
    ARG_UNUSED(inst);
    ARG_UNUSED(dbal_type);
    ARG_UNUSED(service_id);
    ARG_UNUSED(command_id);
    ARG_UNUSED(bytes);
    ARG_UNUSED(data_len);
    ARG_UNUSED(repetition);
    mock_dbal_io_dbus_handler_send_called = true;
    printk("MOCK: __wrap_dbal_io_dbus_handler_send called. Returning %d.\n", mock_dbal_io_dbus_handler_send_return_value);
    return mock_dbal_io_dbus_handler_send_return_value;
}

void __wrap_dbal_clear_msgs_to_repeat(struct dbal_instance* const inst) {
    ARG_UNUSED(inst);
    mock_dbal_clear_msgs_to_repeat_called = true;
    printk("MOCK: __wrap_dbal_clear_msgs_to_repeat called.\n");
}

void __wrap_dbal_clear_retry_counters(struct dbal_instance* const inst) {
    ARG_UNUSED(inst);
    mock_dbal_clear_retry_counters_called = true;
    printk("MOCK: __wrap_dbal_clear_retry_counters called.\n");
}

void __wrap_dbal_connection_sm(struct dbal_instance* const inst, enum DBAL_ConnectionSmEvent event) {
    ARG_UNUSED(inst);
    mock_dbal_connection_sm_called = true;
    mock_dbal_connection_sm_event = event;
    printk("MOCK: __wrap_dbal_connection_sm called with event %u.\n", event);
}

void __wrap_dbal_organize_msgs_to_repeat(struct dbal_instance* const inst) {
    ARG_UNUSED(inst);
    mock_dbal_organize_msgs_to_repeat_called = true;
    printk("MOCK: __wrap_dbal_organize_msgs_to_repeat called.\n");
}

// Mock function implementations for spi_abstraction_init failure cases
const struct device *__wrap_device_dt_get(const struct dt_node_label *label) {
    ARG_UNUSED(label);
    printk("MOCK: __wrap_device_dt_get called. Returning %p.\n", mock_device_dt_get_return_value);
    return mock_device_dt_get_return_value;
}

bool __wrap_device_is_ready(const struct device *dev) {
    ARG_UNUSED(dev);
    printk("MOCK: __wrap_device_is_ready called. Returning %d.\n", mock_device_is_ready_return_value);
    return mock_device_is_ready_return_value;
}

int __wrap_spi_transceive_cb(const struct device *dev, const struct spi_config *config,
                             const struct spi_buf_set *tx_bufs, const struct spi_buf_set *rx_bufs,
                             spi_callback_t callback, void *user_data) {
    ARG_UNUSED(dev);
    ARG_UNUSED(config);
    ARG_UNUSED(tx_bufs);
    ARG_UNUSED(rx_bufs);
    // For re-arming, we need to call the callback directly if it's for RX.
    // In spi_abstraction.c, spi_transceive_cb is called with NULL for tx_bufs for RX re-arming.
    if (tx_bufs == NULL && callback != NULL) {
        // This is a re-arm call for RX. We need to simulate the callback being called.
        // The result of the re-arm itself is controlled by mock_spi_transceive_cb_rearm_return_value.
        printk("MOCK: __wrap_spi_transceive_cb (re-arm) called. Returning %d.\n", mock_spi_transceive_cb_rearm_return_value);
        // We don't call the callback here, as the actual spi_transceive_callback will be called by the test.
        return mock_spi_transceive_cb_rearm_return_value;
    }
    printk("MOCK: __wrap_spi_transceive_cb (initial) called. Returning %d.\n", mock_spi_transceive_cb_return_value);
    return mock_spi_transceive_cb_return_value;
}

// Mock function implementations for spi_transceive_callback
int __wrap_k_msgq_put(struct k_msgq *msgq, const void *data, k_timeout_t timeout) {
    ARG_UNUSED(msgq);
    ARG_UNUSED(data);
    ARG_UNUSED(timeout);
    printk("MOCK: __wrap_k_msgq_put called. Returning %d.\n", mock_k_msgq_put_return_value);
    return mock_k_msgq_put_return_value;
}

// Mock function implementations for k_timer
void __wrap_k_timer_start(struct k_timer *timer, k_timeout_t duration, k_timeout_t period) {
    ARG_UNUSED(timer);
    ARG_UNUSED(duration);
    ARG_UNUSED(period);
    mock_k_timer_start_called = true;
    printk("MOCK: k_timer_start called.\n");
}

void __wrap_k_timer_stop(struct k_timer *timer) {
    ARG_UNUSED(timer);
    mock_k_timer_stop_called = true;
    printk("MOCK: k_timer_stop called.\n");
}

k_timeout_t __wrap_k_timer_remaining_get(struct k_timer *timer) {
    ARG_UNUSED(timer);
    printk("MOCK: k_timer_remaining_get called. Returning %lld.\n", mock_k_timer_remaining_get_return_value.ticks);
    return mock_k_timer_remaining_get_return_value;
}

// Mock function implementations for spi_abstraction
bool spi_abstraction_init(void) {
    printk("MOCK: spi_abstraction_init called. Returning %d.\n", mock_spi_init_return_value);
    return mock_spi_init_return_value;
}

bool spi_abstraction_send(const uint8_t *data, uint8_t len) {
    printk("MOCK: spi_abstraction_send called with len %u.\n", len);
    mock_spi_send_called = true;
    if (len > 0 && len <= 128) {
        memcpy(mock_spi_send_data, data, len);
        mock_spi_send_len = len;
    }
    return true;
}

bool spi_abstraction_receive(uint8_t *buffer, uint8_t len) {
    printk("MOCK: spi_abstraction_receive called with len %u.\n", len);
    // Simulate receiving some data if needed for specific tests
    return true;
}

bool spi_abstraction_transceive(const uint8_t *tx_data, uint8_t *rx_buffer, uint8_t len) {
    printk("MOCK: spi_abstraction_transceive called with len %u.\n", len);
    mock_spi_send_called = true;
    if (len > 0 && len <= sizeof(mock_spi_send_data)) {
        memcpy(mock_spi_send_data, tx_data, len);
        mock_spi_send_len = len;
    }

    if (rx_buffer != NULL && len > 0) {
        if (mock_rx_data_ready) {
            // Use injected RX data if available
            uint8_t copy_len = (len < mock_rx_len_to_inject) ? len : mock_rx_len_to_inject;
            memcpy(rx_buffer, mock_rx_data_to_inject, copy_len);
            mock_rx_data_ready = false; // Reset for next test
            printk("MOCK: Injected RX data used (len: %u).\n", copy_len);
        } else {
            // Simulate a basic command-response if no injected data
            uint8_t dummy_response[] = {
                SPI_SOF_BYTE, // SOF
                0x07, 0x00,   // Length (7 bytes: Service ID, Command ID, Payload, CRC)
                0x01, 0x10,   // Service ID (0x1001)
                0x01, 0x00,   // Command ID (0x0001)
                0x00,         // Payload (Status OK)
                0x00, 0x00    // Dummy CRC
            };
            uint8_t response_len = sizeof(dummy_response);

            if (len >= response_len) {
                memcpy(rx_buffer, dummy_response, response_len);
            } else {
                memcpy(rx_buffer, dummy_response, len);
            }
            printk("MOCK: Dummy RX data used (len: %u).\n", response_len);
        }
    }
    return true;
}

void spi_abstraction_register_rx_callback(spi_rx_callback_t callback) {
    printk("MOCK: spi_abstraction_register_rx_callback called.\n");
    mock_rx_callback = callback;
}

void spi_abstraction_set_rx_msg_queue(struct k_msgq *msg_q) {
    printk("MOCK: spi_abstraction_set_rx_msg_queue called.\n");
    mock_spi_rx_msg_queue = msg_q;
}

// Setup function for the test suite
void dbal_setup(void *fixture) {
    ARG_UNUSED(fixture);
    // Perform any setup needed before each test in the suite
    // For example, reset global state or initialize modules
    mock_spi_send_called = false;
    mock_spi_send_len = 0;
    memset(mock_spi_send_data, 0, sizeof(mock_spi_send_data));
    mock_rx_len_to_inject = 0;
    mock_rx_data_ready = false;
    memset(mock_rx_data_to_inject, 0, sizeof(mock_rx_data_to_inject));
    mock_printk_reset(); // Reset printk buffer for each test
    dbal_reset_service_handlers_for_test(); // Reset service handlers for each test
    mock_spi_init_return_value = true; // Reset mock SPI init return value to success
    mock_k_timer_start_called = false;
    mock_k_timer_stop_called = false;
    mock_k_timer_remaining_get_return_value = K_NO_WAIT;
    mock_dbal_send_connection_message_called = false;
    mock_dbal_send_connection_message_type = DBAL_CON_MSG_TYPE_COUNT;
    mock_dbal_handle_con_msg_tx_fail_called = false;
    mock_dbal_check_task_code_section_flag_return_value = false;
    mock_dbal_set_code_section_flag_called = false;
    mock_dbal_set_code_section_flag_mask = 0;
    mock_dbal_is_msg_of_dbal_type_to_repeat_return_value = false;
    mock_dbal_io_dbus_handler_send_called = false;
    mock_dbal_io_dbus_handler_send_return_value = true;
    mock_dbal_clear_msgs_to_repeat_called = false;
    mock_dbal_clear_retry_counters_called = false;
    mock_dbal_connection_sm_called = false;
    mock_dbal_connection_sm_event = DBAL_CON_SM_EVENT_ENABLE_REQUEST;
    mock_dbal_organize_msgs_to_repeat_called = false;
    mock_device_dt_get_return_value = (const struct device *)1;
    mock_device_is_ready_return_value = true;
    mock_spi_transceive_cb_return_value = 0;
    mock_k_msgq_put_return_value = 0;
    mock_spi_transceive_cb_rearm_return_value = 0;
    mock_spi_read_return_value = 0;
    mock_spi_transceive_blocking_return_value = 0;
    // dbal_init(); // Initialize DBAL for each test if needed
}

// Teardown function for the test suite
void dbal_teardown(void *fixture) {
    ARG_UNUSED(fixture);
    // Perform any cleanup needed after each test in the suite
}
```

## src/test_dbal_init.c
```c
#include <zephyr/ztest.h>
#include "test_common.h"

// Include the application headers to be tested
#include "dbus_app_layer.h"
#include "spi_abstraction.h"

// Test suite for DBAL initialization
ZTEST_SUITE(dbal_init_suite, NULL, NULL, dbal_setup, dbal_teardown, NULL);

ZTEST(dbal_init_suite, test_dbal_init_basic) {
    // Call the initialization function
    dbal_init();

    // Verify that SPI abstraction was initialized and callbacks registered
    zassert_false(mock_spi_send_called, "spi_abstraction_send should not be called during init");
    zassert_not_null(mock_rx_callback, "SPI RX callback should be registered");
    zassert_not_null(mock_spi_rx_msg_queue, "SPI RX message queue should be set");

    // Verify that the target address is set from Kconfig (assuming CONFIG_DBAL_TARGET_ADDRESS is 0x00)
    // This requires access to g_dbal_main_instance, which is static.
    // For proper unit testing, internal state might need to be exposed via getter functions or tested indirectly.
    // For now, we'll assume it's correctly set by the Kconfig system.
    // zassert_equal(g_dbal_main_instance.DBUS_ComPartner, CONFIG_DBAL_TARGET_ADDRESS, "Target address not set correctly");

    printk("DBAL Init Test: Basic initialization passed.\n");
}

ZTEST(dbal_init_suite, test_dbal_init_spi_fail) {
    // Set mock to simulate spi_abstraction_init failure
    mock_spi_init_return_value = false;
    mock_printk_reset(); // Clear printk buffer for this test

    // Call the initialization function
    dbal_init();

    // Verify that SPI abstraction initialization failed
    zassert_true(strstr(mock_printk_buffer, "DBAL_ERROR: Failed to initialize SPI abstraction.") != NULL, "SPI init failure not logged");
    zassert_equal(dbal_get_connection_state(), DBAL_COMMSTATE_DISCONNECTED, "Connection state should remain DISCONNECTED on SPI init failure");

    printk("DBAL Init Test: SPI abstraction initialization failure passed.\n");
}
```

## src/test_dbus_config.c
```c
#include <zephyr/ztest.h>
#include <zephyr/kernel.h>
#include <string.h>
#include "dbus_config.h" // Assuming this header will be found or mocked
#include "dbus_app_layer.h" // For DBAL_MessageType, DBALCR_ParticipantType, DBAL_OWN_NODE_ADDRESS
#include "dbus_config.h" // For DBAL_OWN_NODE_ADDRESS

// Dummy declarations for functions used in tests but not yet fully ported/declared
void DBAL_ntfUnknownDBalFrameReceived(uint8_t sender_node_address, enum DBAL_MessageType dbal_type, uint16_t service_id, uint16_t command_id, const uint8_t* bytes, uint8_t data_len) {
    printk("DBAL_NTF: Unknown DBal Frame Received from 0x%02x (Type: %d, ServiceId: 0x%x, CommandId: 0x%x, DataLen: %u)\n", sender_node_address, dbal_type, service_id, command_id, data_len);
}

void DBAL_ntfUnexpectedDBalFrameReceived(uint8_t sender_node_address, enum DBAL_MessageType dbal_type, uint16_t service_id, uint16_t command_id, const uint8_t* bytes, uint8_t data_len) {
    printk("DBAL_NTF: Unexpected DBal Frame Received from 0x%02x (Type: %d, ServiceId: 0x%x, CommandId: 0x%x, DataLen: %u)\n", sender_node_address, dbal_type, service_id, command_id, data_len);
}

void DBAL_ntfCorruptReqRespDbus2FrameReceived(const uint8_t* bytes, uint8_t data_len) {
    printk("DBAL_NTF: Corrupt Request/Response Dbus2 Frame Received (DataLen: %u)\n", data_len);
}

void DBAL_ntfCorruptConDbus2FrameReceived(const uint8_t* bytes, uint8_t data_len) {
    printk("DBAL_NTF: Corrupt Connection Dbus2 Frame Received (DataLen: %u)\n", data_len);
}

uint8_t DBAL_getTargetAddress(void) {
    return DBAL_OWN_NODE_ADDRESS; // Return a dummy address for testing
}

void DBAL_storeTargetAddress(uint8_t target_address) {
    printk("DBAL_NTF: Storing Target Address: 0x%02x\n", target_address);
}

// Mock for printk to capture output
#define MOCK_PRINTK_BUFFER_SIZE 256
static char mock_printk_buffer[MOCK_PRINTK_BUFFER_SIZE];
static int mock_printk_idx = 0;

void mock_printk(const char *fmt, ...)
{
    va_list args;
    va_start(args, fmt);
    mock_printk_idx += vsnprintk(mock_printk_buffer + mock_printk_idx,
                                 MOCK_PRINTK_BUFFER_SIZE - mock_printk_idx,
                                 fmt, args);
    va_end(args);
}

// Override printk with our mock
#define printk mock_printk

// Test fixture for dbus_config tests
static void *dbus_config_setup(void)
{
    // Reset mock states before each test
    memset(mock_printk_buffer, 0, sizeof(mock_printk_buffer));
    mock_printk_idx = 0;
    return NULL;
}

static void dbus_config_teardown(void *fixture)
{
    // Clean up after each test if necessary
}

ZTEST_SUITE(dbus_config_suite, NULL, dbus_config_setup, NULL, dbus_config_teardown, NULL);

static void test_DBAL_ntfUnknownDBalFrameReceived(void); // Explicit declaration
ZTEST_TEST(test_DBAL_ntfUnknownDBalFrameReceived)
{
    uint8_t sender_node_address = 0x10;
    // Mapping from original DBAL_MESSAGE_TYPE_REQUEST to Zephyr's DBAL_TYPE_CMD for testing purposes
    enum DBAL_MessageType dbal_type = DBAL_TYPE_CMD;
    uint16_t service_id = 0x0100;
    uint16_t command_id = 0x0001;
    uint8_t bytes[] = {0xDE, 0xAD, 0xBE, 0xEF};
    uint8_t data_len = sizeof(bytes);

    DBAL_ntfUnknownDBalFrameReceived(sender_node_address, dbal_type, service_id, command_id, bytes, data_len);

    const char *expected_output_part = "DBAL_NTF: Unknown DBal Frame Received from 0x10 (Type: 0, ServiceId: 0x100, CommandId: 0x1, DataLen: 4)";
    zassert_true(strstr(mock_printk_buffer, expected_output_part) != NULL,
                 "Expected output not found for DBAL_ntfUnknownDBalFrameReceived. Output: %s", mock_printk_buffer);
}

ZTEST_TEST(test_DBAL_ntfUnexpectedDBalFrameReceived)
{
    uint8_t sender_node_address = 0x20;
    // Mapping from original DBAL_MESSAGE_TYPE_RESPONSE to Zephyr's DBAL_TYPE_CMD_ACK for testing purposes
    enum DBAL_MessageType dbal_type = DBAL_TYPE_CMD_ACK;
    uint16_t service_id = 0x0200;
    uint16_t command_id = 0x0002;
    uint8_t bytes[] = {0xAA, 0xBB, 0xCC};
    uint8_t data_len = sizeof(bytes);

    DBAL_ntfUnexpectedDBalFrameReceived(sender_node_address, dbal_type, service_id, command_id, bytes, data_len);

    const char *expected_output_part = "DBAL_NTF: Unexpected DBal Frame Received from 0x20 (Type: 1, ServiceId: 0x200, CommandId: 0x2, DataLen: 3)";
    zassert_true(strstr(mock_printk_buffer, expected_output_part) != NULL,
                 "Expected output not found for DBAL_ntfUnexpectedDBalFrameReceived. Output: %s", mock_printk_buffer);
}

ZTEST_TEST(test_DBAL_ntfCorruptReqRespDbus2FrameReceived)
{
    uint8_t bytes[] = {0x01, 0x02, 0x03};
    uint8_t data_len = sizeof(bytes);

    DBAL_ntfCorruptReqRespDbus2FrameReceived(bytes, data_len);

    const char *expected_output_part = "DBAL_NTF: Corrupt Request/Response Dbus2 Frame Received (DataLen: 3)";
    zassert_true(strstr(mock_printk_buffer, expected_output_part) != NULL,
                 "Expected output not found for DBAL_ntfCorruptReqRespDbus2FrameReceived. Output: %s", mock_printk_buffer);
}

ZTEST_TEST(test_DBAL_ntfCorruptConDbus2FrameReceived)
{
    uint8_t bytes[] = {0xF1, 0xF2};
    uint8_t data_len = sizeof(bytes);

    DBAL_ntfCorruptConDbus2FrameReceived(bytes, data_len);

    const char *expected_output_part = "DBAL_NTF: Corrupt Connection Dbus2 Frame Received (DataLen: 2)";
    zassert_true(strstr(mock_printk_buffer, expected_output_part) != NULL,
                 "Expected output not found for DBAL_ntfCorruptConDbus2FrameReceived. Output: %s", mock_printk_buffer);
}

ZTEST_TEST(test_DBAL_getTargetAddress)
{
    // Assuming DBAL_OWN_NODE_ADDRESS is defined in dbus_app_layer.h or similar
    // For testing, we might need to define it or mock it if it's a macro/global variable.
    // For now, we'll assume it's a constant.
    uint8_t target_address = DBAL_getTargetAddress();
    zassert_equal(target_address, DBAL_OWN_NODE_ADDRESS, "DBAL_getTargetAddress returned incorrect address");
}

ZTEST_TEST(test_DBAL_storeTargetAddress)
{
    uint8_t test_target_address = 0x55;
    DBAL_storeTargetAddress(test_target_address);

    const char *expected_output_part = "DBAL_NTF: Storing Target Address: 0x55";
    zassert_true(strstr(mock_printk_buffer, expected_output_part) != NULL,
                 "Expected output not found for DBAL_storeTargetAddress. Output: %s", mock_printk_buffer);
}
```

## src/test_dbus_spi_integration.c
```c
#include <zephyr/ztest.h>
#include <zephyr/drivers/spi.h>
#include <zephyr/device.h>
#include "spi_abstraction.h" // Assuming this provides the interface to the SPI driver

#define SPI_DEVICE_NODE DT_NODELABEL(flexcomm1) // Use DT_NODELABEL for SPI device

static const struct device *spi_dev = DEVICE_DT_GET(SPI_DEVICE_NODE);

ZTEST_SUITE(dbus_spi_integration_suite, NULL, NULL, NULL, NULL, NULL);

ZTEST_TEST(test_spi_device_presence)
{
    // Verify that the SPI abstraction layer can be initialized
    zassert_true(spi_abstraction_init(), "SPI abstraction layer initialization failed");

    // Verify that the SPI device is ready
    zassert_true(device_is_ready(spi_dev), "SPI device is not ready after abstraction init");

    // Simulate a simple master-initiated transceive to check slave responsiveness
    uint8_t master_tx_buf[] = {0x01, 0x02, 0x03, 0x04};
    uint8_t master_rx_buf[sizeof(master_tx_buf)] = {0};

    struct spi_buf tx_buf = {
        .buf = master_tx_buf,
        .len = sizeof(master_tx_buf)
    };
    struct spi_buf rx_buf = {
        .buf = master_rx_buf,
        .len = sizeof(master_rx_buf)
    };
    struct spi_buf_set tx_bufs = {
        .buffers = &tx_buf,
        .count = 1
    };
    struct spi_buf_set rx_bufs = {
        .buffers = &rx_buf,
        .count = 1
    };

    // This spi_config is for the test acting as a master
    struct spi_config master_spi_cfg = {
        .frequency = 1000000, // 1 MHz
        .operation = SPI_WORD_SET(8) | SPI_TRANSFER_MSB | SPI_OP_MODE_MASTER | SPI_MODE_CPOL | SPI_MODE_CPHA,
        .slave = 0, // Assuming slave select 0
        .cs = NULL, // No software chip select
    };

    int ret = spi_transceive(spi_dev, &master_spi_cfg, &tx_bufs, &rx_bufs);
    zassert_equal(ret, 0, "Master-initiated SPI transceive failed with error: %d", ret);

    // In a slave-mode scenario, the slave might echo data or send a specific response.
    // For now, we just assert that the transceive itself was successful.
    // Further assertions would depend on the expected slave behavior.
    // For example, if the slave echoes, zassert_mem_equal(master_rx_buf, master_tx_buf, sizeof(master_tx_buf));
}

#include <zephyr/init.h>
#include <zephyr/logging/log.h>

LOG_MODULE_REGISTER(dbus_spi_integration_test, LOG_LEVEL_DBG);

// D-Bus service and object path
#define DBUS_BUS_NAME "com.zephyr.DbusSpiService"
#define DBUS_OBJECT_PATH "/com/zephyr/DbusSpi"
#define DBUS_INTERFACE_NAME "com.zephyr.DbusSpi"

// Forward declaration for the D-Bus method handler
static int set_spi_register_handler(struct dbus_conn *conn, struct dbus_message *msg);

// D-Bus method table
static const struct dbus_method dbus_methods[] = {
    DBUS_METHOD("SetSpiRegister", "yy", "", set_spi_register_handler),
    DBUS_METHOD_END
};

// D-Bus interface description
static const struct dbus_interface dbus_iface = {
    .name = DBUS_INTERFACE_NAME,
    .methods = dbus_methods,
};

// D-Bus object description
static const struct dbus_vtable dbus_vtable = {
    .interface = &dbus_iface,
};

// D-Bus object
static const struct dbus_object dbus_obj = {
    .path = DBUS_OBJECT_PATH,
    .vtable = &dbus_vtable_with_signals, // Use the vtable with signals
};

// D-Bus connection
static struct dbus_conn *dbus_conn;

// Global buffer to capture data sent by spi_abstraction_send
#define MAX_SPI_SEND_DATA_LEN 16
static uint8_t spi_sent_data_buffer[MAX_SPI_SEND_DATA_LEN];
static uint8_t spi_sent_data_len = 0;
static K_SEM_DEFINE(spi_send_sem, 0, 1); // Semaphore to signal data sent

// D-Bus method handler implementation
static int set_spi_register_handler(struct dbus_conn *conn, struct dbus_message *msg)
{
    uint8_t reg_addr;
    uint8_t value;
    int ret;

    if (!dbus_message_get_args(msg, NULL, DBUS_TYPE_BYTE, &reg_addr,
                               DBUS_TYPE_BYTE, &value, DBUS_TYPE_INVALID)) {
        LOG_ERR("Failed to parse D-Bus message arguments");
        return dbus_message_reply_error_invalid_args(msg);
    }

    LOG_INF("D-Bus: SetSpiRegister called with addr=0x%02x, value=0x%02x", reg_addr, value);

    // Call the actual SPI abstraction send function
    uint8_t data_to_send[] = {reg_addr, value};
    ret = spi_abstraction_send(data_to_send, sizeof(data_to_send));

    if (ret == false) { // spi_abstraction_send returns bool
        LOG_ERR("SPI send failed");
        return dbus_message_reply_error_internal(msg, "SPI send failed");
    }

    return dbus_message_reply_method_return(msg);
}

// Initialize D-Bus service
static int dbus_spi_service_init(void)
{
    int ret;

    dbus_conn = dbus_conn_get(DBUS_BUS_SYSTEM);
    if (!dbus_conn) {
        LOG_ERR("Failed to get D-Bus system bus connection");
        return -ENODEV;
    }

    ret = dbus_conn_register_object(dbus_conn, &dbus_obj); // Register with signals
    if (ret) {
        LOG_ERR("Failed to register D-Bus object: %d", ret);
        return ret;
    }

    ret = dbus_conn_request_name(dbus_conn, DBUS_BUS_NAME, DBUS_NAME_FLAG_REPLACE_EXISTING);
    if (ret) {
        LOG_ERR("Failed to request D-Bus name: %d", ret);
        return ret;
    }

    LOG_INF("D-Bus SPI service initialized");
    return 0;
}

SYS_INIT(dbus_spi_service_init, APPLICATION, CONFIG_APPLICATION_INIT_PRIORITY);


ZTEST_TEST(test_dbus_message_triggering_spi_write)
{
    int ret;
    struct dbus_message *msg;
    struct dbus_message *reply;
    uint8_t test_reg_addr = 0x10;
    uint8_t test_value = 0xCD;
    uint8_t expected_sent_data[] = {test_reg_addr, test_value};

    // Reset capture buffer and semaphore
    memset(spi_sent_data_buffer, 0, sizeof(spi_sent_data_buffer));
    spi_sent_data_len = 0;
    k_sem_reset(&spi_send_sem);

    // Create a D-Bus method call message
    msg = dbus_message_new_method_call(DBUS_BUS_NAME, DBUS_OBJECT_PATH,
                                       DBUS_INTERFACE_NAME, "SetSpiRegister");
    zassert_not_null(msg, "Failed to create D-Bus message");

    // Append arguments to the message
    dbus_message_append_args(msg, DBUS_TYPE_BYTE, &test_reg_addr,
                             DBUS_TYPE_BYTE, &test_value, DBUS_TYPE_INVALID);

    // Send the D-Bus message and get a reply
    ret = dbus_conn_send_with_reply_and_block(dbus_conn, msg, &reply, DBUS_TIMEOUT_USE_DEFAULT);
    zassert_equal(ret, 0, "D-Bus method call failed: %d", ret);
    zassert_not_null(reply, "D-Bus method call returned no reply");
    zassert_equal(dbus_message_get_type(reply), DBUS_MESSAGE_TYPE_METHOD_RETURN,
                  "D-Bus reply was not a method return, type: %d", dbus_message_get_type(reply));

    dbus_message_unref(msg);
    dbus_message_unref(reply);

    // Now, act as an SPI master to receive the data sent by the slave (our driver)
    uint8_t master_rx_buf[sizeof(expected_sent_data)] = {0};
    uint8_t master_tx_dummy_buf[sizeof(expected_sent_data)] = {0}; // Master sends dummy data to clock out slave's data

    struct spi_buf tx_buf = {
        .buf = master_tx_dummy_buf,
        .len = sizeof(master_tx_dummy_buf)
    };
    struct spi_buf rx_buf = {
        .buf = master_rx_buf,
        .len = sizeof(master_rx_buf)
    };
    struct spi_buf_set tx_bufs = {
        .buffers = &tx_buf,
        .count = 1
    };
    struct spi_buf_set rx_bufs = {
        .buffers = &rx_buf,
        .count = 1
    };

    struct spi_config master_spi_cfg = {
        .frequency = 1000000, // 1 MHz
        .operation = SPI_WORD_SET(8) | SPI_TRANSFER_MSB | SPI_OP_MODE_MASTER | SPI_MODE_CPOL | SPI_MODE_CPHA,
        .slave = 0, // Assuming slave select 0
        .cs = NULL, // No software chip select
    };

    // Give the slave a moment to prepare its send operation
    k_sleep(K_MSEC(10));

    ret = spi_transceive(spi_dev, &master_spi_cfg, &tx_bufs, &rx_bufs);
    zassert_equal(ret, 0, "Master-initiated SPI transceive failed to receive slave data: %d", ret);

    // Assert that the received data matches the expected data
    zassert_mem_equal(master_rx_buf, expected_sent_data, sizeof(expected_sent_data),
                       "Received SPI data does not match expected data");
}

// D-Bus signal definition
#define DBUS_SIGNAL_NAME "SpiEventOccurred"

// Global flag to indicate if the signal was received
static volatile bool spi_event_signal_received = false;

// D-Bus signal handler
static int spi_event_signal_handler(struct dbus_conn *conn, struct dbus_message *msg)
{
    LOG_INF("D-Bus: SpiEventOccurred signal received");
    spi_event_signal_received = true;
    return 0;
}

// D-Bus signal table
static const struct dbus_signal dbus_signals[] = {
    DBUS_SIGNAL(DBUS_SIGNAL_NAME, "", ""),
    DBUS_SIGNAL_END
};

// Update D-Bus interface description to include signals
static const struct dbus_interface dbus_iface_with_signals = {
    .name = DBUS_INTERFACE_NAME,
    .methods = dbus_methods,
    .signals = dbus_signals,
};

// Update D-Bus object description to use the interface with signals
static const struct dbus_vtable dbus_vtable_with_signals = {
    .interface = &dbus_iface_with_signals,
};

// Update D-Bus object
static const struct dbus_object dbus_obj_with_signals = {
    .path = DBUS_OBJECT_PATH,
    .vtable = &dbus_vtable_with_signals,
};

// Function to simulate an SPI event (to be called by the test)
// In a real scenario, this would be triggered by an actual hardware interrupt
void spi_abstraction_simulate_event(void)
{
    // Use the test helper function to inject simulated RX data
    uint8_t simulated_rx_data[] = {0xAA, 0xBB, 0xCC};
    spi_abstraction_test_inject_rx_data(simulated_rx_data, sizeof(simulated_rx_data));
}


ZTEST_TEST(test_spi_event_triggering_dbus_signal)
{
    int ret;
    struct dbus_message *msg;

    spi_event_signal_received = false; // Reset flag for this test

    // Add a match rule to receive the signal
    ret = dbus_conn_add_match(dbus_conn,
                              "type='signal',interface='" DBUS_INTERFACE_NAME "',member='" DBUS_SIGNAL_NAME "'",
                              spi_event_signal_handler);
    zassert_equal(ret, 0, "Failed to add D-Bus match rule: %d", ret);

    // Simulate an SPI event
    spi_abstraction_simulate_event();

    // Give some time for the D-Bus signal to be processed
    k_sleep(K_MSEC(100));

    // Assert that the signal was received
    zassert_true(spi_event_signal_received, "D-Bus signal SpiEventOccurred was not received");

    // Remove the match rule
    ret = dbus_conn_remove_match(dbus_conn,
                                 "type='signal',interface='" DBUS_INTERFACE_NAME "',member='" DBUS_SIGNAL_NAME "'",
                                 spi_event_signal_handler);
    zassert_equal(ret, 0, "Failed to remove D-Bus match rule: %d", ret);
}
```
