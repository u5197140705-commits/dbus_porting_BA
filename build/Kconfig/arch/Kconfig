## build/Kconfig/soc/Kconfig.tmp
```kconfig
# Load Zephyr SoC Kconfig descriptions.
osource "/home/swied/zephyrproject/zephyr/soc/xlnx/zynqmp/Kconfig"
osource "/home/swied/zephyrproject/zephyr/soc/xlnx/zynq7000/Kconfig"
osource "/home/swied/zephyrproject/zephyr/soc/xlnx/versalnet/Kconfig"
osource "/home/swied/zephyrproject/zephyr/soc/xlnx/versal2/Kconfig"
osource "/home/swied/zephyrproject/zephyr/soc/xlnx/versal/Kconfig"
osource "/home/swied/zephyrproject/zephyr/soc/xen/Kconfig"
osource "/home/swied/zephyrproject/zephyr/soc/wch/ch32v/Kconfig"
osource "/home/swied/zephyrproject/zephyr/soc/ti/simplelink/Kconfig"
osource "/home/swied/zephyrproject/zephyr/soc/ti/mspm0/Kconfig"
osource "/home/swied/zephyrproject/zephyr/soc/ti/lm3s6965/Kconfig"
osource "/home/swied/zephyrproject/zephyr/soc/ti/k3/Kconfig"
osource "/home/swied/zephyrproject/zephyr/soc/telink/tlsr/Kconfig"
osource "/home/swied/zephyrproject/zephyr/soc/starfive/jh71xx/Kconfig"
osource "/home/swied/zephyrproject/zephyr/soc/st/stm32/Kconfig"
osource "/home/swied/zephyrproject/zephyr/soc/snps/qemu_arc/Kconfig"
osource "/home/swied/zephyrproject/zephyr/soc/snps/nsim/arc_v/Kconfig"
osource "/home/swied/zephyrproject/zephyr/soc/snps/nsim/arc_classic/Kconfig"
osource "/home/swied/zephyrproject/zephyr/soc/snps/hsdk4xd/Kconfig"
osource "/home/swied/zephyrproject/zephyr/soc/snps/hsdk/Kconfig"
osource "/home/swied/zephyrproject/zephyr/soc/snps/emsk/Kconfig"
osource "/home/swied/zephyrproject/zephyr/soc/snps/emsdp/Kconfig"
osource "/home/swied/zephyrproject/zephyr/soc/snps/arc_iot/Kconfig"
osource "/home/swied/zephyrproject/zephyr/soc/silabs/Kconfig"
osource "/home/swied/zephyrproject/zephyr/soc/sifli/sf32/Kconfig"
osource "/home/swied/zephyrproject/zephyr/soc/sifive/sifive_freedom/Kconfig"
osource "/home/swied/zephyrproject/zephyr/soc/sensry/Kconfig"
osource "/home/swied/zephyrproject/zephyr/soc/rockchip/Kconfig"
osource "/home/swied/zephyrproject/zephyr/soc/renode/riscv_virtual/Kconfig"
osource "/home/swied/zephyrproject/zephyr/soc/renode/cortex_r8_virtual/Kconfig"
osource "/home/swied/zephyrproject/zephyr/soc/renesas/smartbond/Kconfig"
osource "/home/swied/zephyrproject/zephyr/soc/renesas/rz/Kconfig"
osource "/home/swied/zephyrproject/zephyr/soc/renesas/rx/Kconfig"
osource "/home/swied/zephyrproject/zephyr/soc/renesas/rcar/Kconfig"
osource "/home/swied/zephyrproject/zephyr/soc/renesas/ra/Kconfig"
osource "/home/swied/zephyrproject/zephyr/soc/realtek/ec/Kconfig"
osource "/home/swied/zephyrproject/zephyr/soc/realtek/ameba/Kconfig"
osource "/home/swied/zephyrproject/zephyr/soc/raspberrypi/rpi_pico/Kconfig"
osource "/home/swied/zephyrproject/zephyr/soc/quicklogic/eos_s3/Kconfig"
osource "/home/swied/zephyrproject/zephyr/soc/qemu/virt_riscv/Kconfig"
osource "/home/swied/zephyrproject/zephyr/soc/qemu/malta/Kconfig"
osource "/home/swied/zephyrproject/zephyr/soc/openisa/rv32m1/Kconfig"
osource "/home/swied/zephyrproject/zephyr/soc/openhwgroup/cva6/Kconfig"
osource "/home/swied/zephyrproject/zephyr/soc/oct/osd32mp15x/Kconfig"
osource "/home/swied/zephyrproject/zephyr/soc/nxp/s32/Kconfig"
osource "/home/swied/zephyrproject/zephyr/soc/nxp/rw/Kconfig"
osource "/home/swied/zephyrproject/zephyr/soc/nxp/mcx/Kconfig"
osource "/home/swied/zephyrproject/zephyr/soc/nxp/lpc/Kconfig"
osource "/home/swied/zephyrproject/zephyr/soc/nxp/layerscape/Kconfig"
osource "/home/swied/zephyrproject/zephyr/soc/nxp/kinetis/Kconfig"
osource "/home/swied/zephyrproject/zephyr/soc/nxp/imxrt/Kconfig"
osource "/home/swied/zephyrproject/zephyr/soc/nxp/imx/Kconfig"
osource "/home/swied/zephyrproject/zephyr/soc/nuvoton/numicro/Kconfig"
osource "/home/swied/zephyrproject/zephyr/soc/nuvoton/numaker/Kconfig"
osource "/home/swied/zephyrproject/zephyr/soc/nuvoton/npcx/Kconfig"
osource "/home/swied/zephyrproject/zephyr/soc/nuvoton/npcm/Kconfig"
osource "/home/swied/zephyrproject/zephyr/soc/nordic/Kconfig"
osource "/home/swied/zephyrproject/zephyr/soc/neorv32/Kconfig"
osource "/home/swied/zephyrproject/zephyr/soc/native/inf_clock/Kconfig"
osource "/home/swied/zephyrproject/zephyr/soc/microchip/sam/sama7/Kconfig"
osource "/home/swied/zephyrproject/zephyr/soc/microchip/sam/sam_d5x_e5x/Kconfig"
osource "/home/swied/zephyrproject/zephyr/soc/microchip/pic32c/pic32cz_ca/Kconfig"
osource "/home/swied/zephyrproject/zephyr/soc/microchip/pic32c/pic32cx_sg/Kconfig"
osource "/home/swied/zephyrproject/zephyr/soc/microchip/pic32c/pic32cm_jh/Kconfig"
osource "/home/swied/zephyrproject/zephyr/soc/microchip/miv/Kconfig"
osource "/home/swied/zephyrproject/zephyr/soc/microchip/mec/Kconfig"
osource "/home/swied/zephyrproject/zephyr/soc/mediatek/mt8xxx/Kconfig"
osource "/home/swied/zephyrproject/zephyr/soc/lowrisc/opentitan/Kconfig"
osource "/home/swied/zephyrproject/zephyr/soc/litex/litex_vexriscv/Kconfig"
osource "/home/swied/zephyrproject/zephyr/soc/ite/ec/Kconfig"
osource "/home/swied/zephyrproject/zephyr/soc/intel/wildcat_lake/Kconfig"
osource "/home/swied/zephyrproject/zephyr/soc/intel/raptor_lake/Kconfig"
osource "/home/swied/zephyrproject/zephyr/soc/intel/panther_lake/Kconfig"
osource "/home/swied/zephyrproject/zephyr/soc/intel/lakemont/Kconfig"
osource "/home/swied/zephyrproject/zephyr/soc/intel/intel_socfpga_std/Kconfig"
osource "/home/swied/zephyrproject/zephyr/soc/intel/intel_socfpga/Kconfig"
osource "/home/swied/zephyrproject/zephyr/soc/intel/intel_niosv/Kconfig"
osource "/home/swied/zephyrproject/zephyr/soc/intel/intel_ish/Kconfig"
osource "/home/swied/zephyrproject/zephyr/soc/intel/intel_adsp/Kconfig"
osource "/home/swied/zephyrproject/zephyr/soc/intel/elkhart_lake/Kconfig"
osource "/home/swied/zephyrproject/zephyr/soc/intel/atom/Kconfig"
osource "/home/swied/zephyrproject/zephyr/soc/intel/apollo_lake/Kconfig"
osource "/home/swied/zephyrproject/zephyr/soc/intel/alder_lake/Kconfig"
osource "/home/swied/zephyrproject/zephyr/soc/infineon/psoc4/Kconfig"
osource "/home/swied/zephyrproject/zephyr/soc/infineon/edge/Kconfig"
osource "/home/swied/zephyrproject/zephyr/soc/infineon/cat3/Kconfig"
osource "/home/swied/zephyrproject/zephyr/soc/infineon/cat1c/Kconfig"
osource "/home/swied/zephyrproject/zephyr/soc/infineon/cat1b/Kconfig"
osource "/home/swied/zephyrproject/zephyr/soc/infineon/cat1a/Kconfig"
osource "/home/swied/zephyrproject/zephyr/soc/gd/gd32/Kconfig"
osource "/home/swied/zephyrproject/zephyr/soc/gaisler/leon3/Kconfig"
osource "/home/swied/zephyrproject/zephyr/soc/gaisler/gr716a/Kconfig"
osource "/home/swied/zephyrproject/zephyr/soc/focaltech/Kconfig"
osource "/home/swied/zephyrproject/zephyr/soc/espressif/Kconfig"
osource "/home/swied/zephyrproject/zephyr/soc/ene/kb1200/Kconfig"
osource "/home/swied/zephyrproject/zephyr/soc/ene/kb106x/Kconfig"
osource "/home/swied/zephyrproject/zephyr/soc/elan/em32f967/Kconfig"
osource "/home/swied/zephyrproject/zephyr/soc/egis/Kconfig"
osource "/home/swied/zephyrproject/zephyr/soc/efinix/sapphire/Kconfig"
osource "/home/swied/zephyrproject/zephyr/soc/cdns/xtensa_sample_controller/Kconfig"
osource "/home/swied/zephyrproject/zephyr/soc/cdns/sample_controller32/Kconfig"
osource "/home/swied/zephyrproject/zephyr/soc/cdns/dc233c/Kconfig"
osource "/home/swied/zephyrproject/zephyr/soc/brcm/bcmvk/Kconfig"
osource "/home/swied/zephyrproject/zephyr/soc/brcm/bcm2712/Kconfig"
osource "/home/swied/zephyrproject/zephyr/soc/brcm/bcm2711/Kconfig"
osource "/home/swied/zephyrproject/zephyr/soc/bflb/Kconfig"
osource "/home/swied/zephyrproject/zephyr/soc/atmel/sam0/Kconfig"
osource "/home/swied/zephyrproject/zephyr/soc/atmel/sam/Kconfig"
osource "/home/swied/zephyrproject/zephyr/soc/aspeed/Kconfig"
osource "/home/swied/zephyrproject/zephyr/soc/arm/Kconfig"
osource "/home/swied/zephyrproject/zephyr/soc/arm/beetle/Kconfig"
osource "/home/swied/zephyrproject/zephyr/soc/antmicro/myra/Kconfig"
osource "/home/swied/zephyrproject/zephyr/soc/andestech/Kconfig"
osource "/home/swied/zephyrproject/zephyr/soc/amd/acp_6_0/Kconfig"
osource "/home/swied/zephyrproject/zephyr/soc/ambiq/Kconfig"
osource "/home/swied/zephyrproject/zephyr/soc/allwinner/sun8i_h3/Kconfig"
osource "/home/swied/zephyrproject/zephyr/soc/aesc/Kconfig"
osource "/home/swied/zephyrproject/zephyr/soc/adi/max32/Kconfig"
```

## dbuscan_slave_stub/build/Kconfig/boards/Kconfig
```kconfig
# Load Zephyr board Kconfig descriptions.
osource "/home/wis3re/zephyrproject/zephyr/boards/st/nucleo_g071rb/Kconfig"
```

## dbuscan_slave_stub/build/Kconfig/boards/Kconfig.defconfig
```kconfig
# Load Zephyr board defconfig descriptions.
osource "/home/wis3re/zephyrproject/zephyr/boards/st/nucleo_g071rb/Kconfig.defconfig"
```

## west.yml
```yaml
manifest:
  defaults:
    remote: upstream

  remotes:
    - name: upstream
      url-base: https://github.com/zephyrproject-rtos

  projects:
    - name: zephyr
      path: zephyr
    - name: zephyr_dbus_driver
      path: zephyr_dbus_driver
```

## zephyr_dbus_driver/build_app/Kconfig/boards/Kconfig.defconfig
```kconfig
# Load Zephyr board defconfig descriptions.
osource "/home/wis3re/zephyrproject/zephyr/boards/nxp/frdm_rw612/Kconfig.defconfig"
```

## zephyr_dbus_driver/tests/testcase.yaml
```yaml
tests:
  dbus_driver.unit_tests:
    build_only: true
    platform_allow:
      - frdm_rw612
    tags:
      - dbus_driver
      - unit_test
```

## zephyr_spi_master_test_app/build/Kconfig/boards/Kconfig.frdm_rw612
```kconfig
# Load board Kconfig descriptions.
osource "/home/wis3re/zephyrproject/zephyr/boards/nxp/frdm_rw612/Kconfig.frdm_rw612"
```
